## Config.in
```kconfig
source "$BR2_EXTERNAL_D200_BUILDROOT_PATH/package/d200-rkbin/Config.in"
source "$BR2_EXTERNAL_D200_BUILDROOT_PATH/package/d200-utils/Config.in"
source "$BR2_EXTERNAL_D200_BUILDROOT_PATH/package/d200-deck/Config.in"
```

## board/ulanzi/d200/kernel.its
```
/* 0x00200000: start of RAM after BL31 */
/dts-v1/;

/ {
	description = "Ulanzi D200 Linux";
	#address-cells = <1>;

	images {
		kernel {
			description = "Linux kernel";
			data = /incbin/("Image.gz");
			type = "kernel";
			arch = "arm64";
			os = "linux";
			compression = "gzip";
			load = <0x00200000>;
			entry = <0x00200000>;
			hash {
				algo = "sha256";
			};
		};

		fdt {
			description = "Ulanzi D200 device tree";
			data = /incbin/("rk3308-ulanzi-d200.dtb");
			type = "flat_dt";
			arch = "arm64";
			compression = "none";
			hash {
				algo = "sha256";
			};
		};

		fdt-panel-h3 {
			description = "Ulanzi D200 h3 panel overlay";
			data = /incbin/("rk3308-ulanzi-d200-panel-h3.dtbo");
			type = "flat_dt";
			arch = "arm64";
			compression = "none";
			hash {
				algo = "sha256";
			};
		};
	};

	/* One per panel, named as U-Boot's d200_panel */
	configurations {
		default = "h1";

		h1 {
			description = "Ulanzi D200, h1 panel";
			kernel = "kernel";
			fdt = "fdt";
		};

		h3 {
			description = "Ulanzi D200, h3 panel";
			kernel = "kernel";
			fdt = "fdt", "fdt-panel-h3";
		};
	};
};
```

## package/d200-deck/Config.in
```kconfig
config BR2_PACKAGE_D200_DECK
	bool "d200-deck"
	depends on BR2_PACKAGE_HOST_GO_TARGET_ARCH_SUPPORTS
	help
	  deckd: shows pages of buttons on the D200 screen and runs
	  their actions (USB HID keys, media keys, macros); serves the
	  config channel and the update page.

	  https://github.com/riptidewave93/d200-deck
```

## package/d200-rkbin/Config.in
```kconfig
config BR2_PACKAGE_D200_RKBIN
	bool "d200-rkbin"
	depends on BR2_aarch64
	help
	  Rockchip rkbin blobs (BL31, DDR init TPL) and Rockchip's
	  raw NAND flash loader (built with rkbin's boot_merger), at
	  a selectable rkbin commit. Buildroot's own rockchip-rkbin
	  package pins an older rkbin and has no version override.

	  https://github.com/rockchip-linux/rkbin

if BR2_PACKAGE_D200_RKBIN

config BR2_PACKAGE_D200_RKBIN_VERSION
	string "rkbin git commit"
	default "3e288fe814e059dd06833495f845cab04ac20a5c"
	help
	  Commit of https://github.com/rockchip-linux/rkbin to use.

config BR2_PACKAGE_D200_RKBIN_TPL_FILENAME
	string "TPL (DDR init) file path in rkbin"
	default "bin/rk33/rk3308_ddr_589MHz_uart2_m1_v2.11.bin"

config BR2_PACKAGE_D200_RKBIN_BL31_FILENAME
	string "BL31 file path in rkbin"
	default "bin/rk33/rk3308_bl31_v2.28.elf"

endif
```

## package/d200-utils/Config.in
```kconfig
config BR2_PACKAGE_D200_UTILS
	bool "d200-utils"
	help
	  Small tools for the Ulanzi D200:
	  reboot-to [normal|fastboot|maskrom]   reboot into a boot mode
```
